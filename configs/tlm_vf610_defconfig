## crazyflie/Kconfig
```kconfig
menuconfig CRAZYFLIE
	bool "Crazyflie"
	select USE_APPLICATION_TASK_TAG
	select USE_TIMERS
	select SENSOR
	select MPU9250
	select ACCEL
	select GYRO
	depends on MOTOR
	default n
	config PIDVALUES_CRAZYFLIE
		bool "PID Values of Crazyflie"
		depends on CRAZYFLIE
		default n
	config PIDVALUES_TCM
		bool "PID Values of TCM"
		depends on CRAZYFLIE
		default y
	config MOTOR_ESC_MIN
		int "Motor ESC Min Time"
		depends on CRAZYFLIE
		default 1050
	config MOTOR_ESC_MAX
		int "Motor ESC Min Time"
		depends on CRAZYFLIE
		default 1860
	config MOTOR_TEST
		bool "Activate Motor Test"
		depends on CRAZYFLIE
		default n
		help
			Activate Motor Test every System start
```

## src/Kconfig
```kconfig
menu "Aplication Settings"
config DISPLAY
	bool "Activate Display"
	default n
	depends on CRAZYFLIE
config MOTOR
	bool "ESC Motor Control"
	default y
	help 
		Motor Interface

			-----------------
			| Motor | Motor |
			|   3   |   0   |
			|  CW   |  CCW  |
			|----------------
			| Motor | Motor |
			|   2   |   1   |
			|  CCW  |  CW   |
			-----------------
	config MOTOR_ID_0
		int "PWM ID for Motor 0"
		default 3
		depends on MOTOR
		help
			PWM ID for Motor 0
	config MOTOR_ID_1
		int "PWM ID for Motor 1"
		default 6
		depends on MOTOR
		help
			PWM ID for Motor 1
	config MOTOR_ID_2
		int "PWM ID for Motor 2"
		default 0
		depends on MOTOR
		help
			PWM ID for Motor 2
	config MOTOR_ID_3
		int "PWM ID for Motor 3"
		default 2
		depends on MOTOR
		help
			PWM ID for Motor 3
	config MOTOR_OFF
		depends on MOTOR
		bool "Init PWM only No Motor Contoll"
		default n
	config MOTORTEST
		bool "Motor Test: Warinung Motor speed up to maximum"
		depends on MOTOR
		default n
	config EMERGENCY
		bool "Activate Emergency Mangement"
		default y
		depends on MOTOR
		help
			Activate Emergency Mangement
	
config RC
	bool "Activate Remote Control by Spectrum Receiver"
	depends on CAPTURE
	default y
	help
		Activate Remote Control by Spectrum Receiver
	config RC_COMM_ROLL_ID
		int "Caputre Interface ID for Roll"
		default 2
		depends on RC
		help
			Capture Interface ID for Roll Input
	config RC_COMM_PITCH_ID
		int "Caputre Interface ID for Pitch"
		default 4
		depends on RC
		help
			Capture Interface ID for Pitch Input
	config RC_COMM_YAW_ID
		int "Caputre Interface ID for Yaw"
		default 5
		depends on RC
		help
			Capture Interface ID for Yaw Input
	config RC_COMM_THRUST_ID
		int "Caputre Interface ID for Thrust"
		default 6
		depends on RC
		help
			Capture Interface ID for Thrust Input
	config RC_COMMANDER
		bool "Activate Remote Contol Commander"
		default y
		depends on CRAZYFLIE && RC
		help
			Activate Remote Control Commander over Spectrum Receiver
	config RC_MOTORTEST
		depends on RC
		depends on MOTOR
		bool "Motor Test over RC"
		default n
config LC
	bool "Activate Linux Client over Buffer Driver"
	depends on BUFFER 
	default y
	config LC_COMMANDER
		bool "Activate Linux Commander"
		default y
		depends on CRAZYFLIE && LC
		help
			Activate Linux Commander over Buffer Driver

comment "Warning no Receiver select"
	depends on CRAZYFLIE && (!LC_COMMANDER && !RC_COMMANDER)
choice 
	prompt "Select Default Receiver"
	depends on CRAZYFLIE && (RC_COMMANDER || LC_COMMANDER)
	config DEFAULT_RC_SPECTRUM
		bool "Spectrum Receiver"
		depends on RC_COMMANDER
		help
			Default RC is Spectrum Receiver
	config DEFAULT_RC_LINUX
		bool "Linux Receiver"
		depends on BUFFER
		depends on LC_COMMANDER
		help
			Default RC is Linux Receiver
endchoice
config APP_INCLUDE
	string
	default "-Icrazyflie/include/ -Icrazyflie/modules/interface/ -Icrazyflie/hal/interface/ -Icrazyflie/utils/interface/ -Icrazyflie/drivers/interface/"
config APP_LIBS
	string
	default "-lm"
endmenu
```
